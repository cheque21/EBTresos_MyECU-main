AUTOSAR XML (schema 4-2-2)
package /ComponentTypes
  application sw component type BrakeController
    behavior BrakeController_InternalBehavior
  swc implementation BrakeController_Implementation: behavior=BrakeController_InternalBehavior
